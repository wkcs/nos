## arch/arm/Kconfig
```kconfig
#
# ARM 架构配置
#

if ARCH_ARM

choice
	prompt "ARM CPU Type"
	default ARM_CORTEX_M4
	help
	  选择 ARM CPU 类型。

config ARM_CORTEX_M3
	bool "Cortex-M3"
	help
	  ARM Cortex-M3 处理器支持。

config ARM_CORTEX_M4
	bool "Cortex-M4"
	help
	  ARM Cortex-M4 处理器支持（带 FPU）。

config ARM_CORTEX_A7
	bool "Cortex-A7"
	select ARCH_HAS_MMU
	help
	  ARM Cortex-A7 处理器支持。

endchoice

config CPU_TYPE
	string
	default "cortex-m3" if ARM_CORTEX_M3
	default "cortex-m4" if ARM_CORTEX_M4
	default "cortex-a7" if ARM_CORTEX_A7

config ARM_CORTEX_CPU
	bool
	default y
	help
	  ARM Cortex 系列 CPU。

config ARM_CORTEX_M4_FPU
	bool "Enable Cortex-M4 FPU (FPv4-SP-D16)"
	default y
	depends on ARM_CORTEX_M4
	help
	  启用 Cortex-M4 硬件单精度浮点单元。

config THUMB2_KERNEL
	bool "Use Thumb-2 instruction set"
	default y
	depends on ARM_CORTEX_M3 || ARM_CORTEX_M4
	help
	  使用 Thumb-2 指令集编译内核。
	  Cortex-M 系列处理器推荐启用。

config KERNEL_USE_BOOTLOADER
	bool "Kernel uses bootloader"
	default y
	help
	  内核通过 bootloader 加载。
	  如果启用，内核地址需要与 bootloader 配置匹配。

config KERNEL_ADDR
	hex "Kernel load address"
	default 0x08000000
	depends on KERNEL_USE_BOOTLOADER
	help
	  内核加载地址（十六进制）。
	  通常为 Flash 起始地址。

config ARM_MPU_FLASH_BASE
	hex "ARMv7-M MPU static flash region base address"
	default 0x00000000 if SOC_NUC472
	default 0x08000000
	help
	  ARMv7-M MPU 保护的片上 Flash 静态区域物理基地址。
	  NUC472 默认为 0x00000000，STM32 等芯片通常为 0x08000000。

config ARM_MPU_FLASH_SIZE
	hex "ARMv7-M MPU static flash region size in bytes"
	default 0x80000 if SOC_NUC472
	default 0x100000
	help
	  ARMv7-M MPU 保护的片上 Flash 静态区域大小（字节数）。
	  必须为 2 的整数次幂（如 512 KiB 为 0x80000，1 MiB 为 0x100000）。

config ARM_MPU_SRAM_BASE
	hex "ARMv7-M MPU static SRAM region base address"
	default 0x20000000
	help
	  ARMv7-M MPU 保护的片上 SRAM 静态区域物理基地址。
	  ARM Cortex-M 架构通常统一映射在 0x20000000。

config ARM_MPU_SRAM_SIZE
	hex "ARMv7-M MPU static SRAM region size in bytes"
	default 0x10000 if SOC_NUC472
	default 0x20000
	help
	  ARMv7-M MPU 保护的片上 SRAM 静态区域大小（字节数）。
	  必须为 2 的整数次幂（如 64 KiB 为 0x10000，128 KiB 为 0x20000）。

endif # ARCH_ARM
```

## arch/arm64/Kconfig
```kconfig
#
# ARM64 架构配置
#

if ARCH_ARM64

choice
	prompt "ARM64 CPU Type"
	default ARM64_CORTEX_A53
	help
	  选择 ARM64 CPU 类型。

config ARM64_CORTEX_A53
	bool "Cortex-A53"
	help
	  ARM Cortex-A53 处理器支持。

config ARM64_CORTEX_A72
	bool "Cortex-A72"
	help
	  ARM Cortex-A72 处理器支持。

config ARM64_CORTEX_A76
	bool "Cortex-A76"
	help
	  ARM Cortex-A76（ARMv8.2-A，端侧 AI SoC 如 RK3588 大核）处理器支持。

config ARM64_GENERIC
	bool "Generic ARMv8-A"
	help
	  通用 ARMv8-A 架构支持。

config ARM64_GENERIC_V9
	bool "Generic ARMv9-A"
	help
	  通用 ARMv9-A 架构支持（SVE2 / BTI / PAC 等增强特性）。

endchoice

config CPU_TYPE
	string
	default "cortex-a53" if ARM64_CORTEX_A53
	default "cortex-a72" if ARM64_CORTEX_A72
	default "cortex-a76" if ARM64_CORTEX_A76
	default "generic-v9" if ARM64_GENERIC_V9
	default "generic" if ARM64_GENERIC

config ARM64_4K_PAGES
	bool "4KB page size"
	default y
	help
	  使用 4KB 页面大小。

config ARM64_64K_PAGES
	bool "64KB page size"
	depends on !ARM64_4K_PAGES
	help
	  使用 64KB 页面大小。

config ARM64_VA_BITS
	int "Virtual address space size"
	default 39
	range 36 48
	help
	  虚拟地址空间位数。
	  39 位支持 512GB 虚拟地址空间（3 级 4KB 页表）。

config ARM64_PA_BITS
	int "Physical address space size"
	default 40
	range 36 48
	help
	  物理地址空间位数。

config ARM64_GICV3
	bool "Enable GICv3 support (with runtime GICv2 fallback)"
	default y
	help
	  启用 GICv3 系统寄存器中断驱动，并在运行时自动兼容 GICv2 平台。

config ARM64_KERNEL_NO_FP
	bool "Disable FP/SIMD registers in EL1 kernel (-mgeneral-regs-only)"
	default y
	help
	  禁止内核 EL1 代码隐式使用 FP/SIMD/SVE 寄存器，以支持低开销惰性向量上下文切换。

config ARM64_STAGE2_SELFTEST
	bool "Run ARM64 Stage 2 SMP and EL0 isolation selftest on boot"
	default n
	help
	  开机自检多核 PSCI SMP、真实 EL0 用户态降级、SVC #0 边界与硬件异常隔离。

endif # ARCH_ARM64
```

## configs/nutiny-nuc472_defconfig
```kconfig
CONFIG_ARCH_ARM=y
CONFIG_ARM_CORTEX_M4=y
CONFIG_ARM_CORTEX_M4_FPU=y
CONFIG_THUMB2_KERNEL=y
CONFIG_KERNEL_USE_BOOTLOADER=n
CONFIG_BOARD_NUTINY_NUC472=y
CONFIG_SOC_NUC472=y
CONFIG_UART_NUC472=y
CONFIG_PAGE_SIZE=1024
CONFIG_SYS_TICK_MS=10
CONFIG_MAX_PRIORITY=32
CONFIG_IDEL_TASK_STACK_SIZE=2048
CONFIG_CORE_TASK_STACK_SIZE=2048
CONFIG_MAX_ORDER=6
CONFIG_DEFAULT_CONSOLE="tty0"
CONFIG_LOG_FIFO_BUF_SIZE=512
CONFIG_DEVICE_TREE=y
CONFIG_NUC472_GPIO=y
CONFIG_GPIO_NUC472=y
CONFIG_NUC472_SPI=y
CONFIG_SPI_NUC472=y
CONFIG_NUC472_I2C=y
CONFIG_I2C_NUC472=y
CONFIG_PWM_NUC472=y
CONFIG_EADC_NUC472=y
CONFIG_TIMER_NUC472=y
CONFIG_RTC_NUC472=y
CONFIG_WDT_NUC472=y
CONFIG_EMAC_PROBE_NUC472=y
CONFIG_SHELL=y
CONFIG_MM_TLSF=y
CONFIG_MM_SLUB=n
CONFIG_MPU=y
CONFIG_MPU_STACK_GUARD=y
CONFIG_LITTLEFS=y
CONFIG_FATFS=n
CONFIG_RAMDISK=n
CONFIG_FLASH_NUC472_FMC=y
CONFIG_USB=y
CONFIG_USB_DEVICE=y
CONFIG_USB_WINUSB=y
CONFIG_USB_CDC=y
CONFIG_USB_HID=y
CONFIG_USB_DEVICE_COMPOSITE=y
CONFIG_USB_DEVICE_WINUSB=y
CONFIG_USB_DEVICE_CDC=y
CONFIG_USB_DEVICE_HID=y
CONFIG_USB_NUC472_USBD=y
CONFIG_NLK_SERVER=y
CONFIG_LUA=y
CONFIG_LUA_BOOT_TEST=n
CONFIG_LUA_SHELL_CMD=y
CONFIG_KALLSYMS=n
```

## configs/qemu-virt-arm64_defconfig
```kconfig
# QEMU Virt ARM64 Configuration (Cortex-A53 Higher-Half Hybrid Kernel)
CONFIG_ARCH_ARM64=y
CONFIG_ARM64_CORTEX_A53=y
CONFIG_ARM64_4K_PAGES=y
CONFIG_ARM64_VA_BITS=39
CONFIG_ARM64_PA_BITS=40
CONFIG_ARM64_GICV3=y
CONFIG_ARM64_KERNEL_NO_FP=y
CONFIG_BOARD_QEMU_VIRT=y
CONFIG_SOC_QEMU_VIRT=y
CONFIG_QEMU=y
CONFIG_KERNEL_MICROKERNEL=y
CONFIG_MMU=y
CONFIG_LIBC_MUSL=y
CONFIG_POSIX=y
CONFIG_PAGE_SIZE=4096
CONFIG_SYS_TICK_MS=1
CONFIG_MAX_PRIORITY=32
CONFIG_STACK_GROWSUP=n
CONFIG_IDEL_TASK_STACK_SIZE=4096
CONFIG_CORE_TASK_STACK_SIZE=16384
CONFIG_MAX_ORDER=10
CONFIG_KALLSYMS=y
CONFIG_STACK_BACKTRACE=y
CONFIG_TTY=y
CONFIG_DEFAULT_CONSOLE="tty0"
CONFIG_CONSOLE_CRLF=y
CONFIG_UART_RX_BUFFER_SIZE=256
CONFIG_UART_TX_BUFFER_SIZE=512
CONFIG_DEFAULT_LOG_LEVEL=0
CONFIG_SHELL=y
CONFIG_SHELL_CONSOLE=y
CONFIG_SHELL_STACK_SIZE=16384
CONFIG_DEVICE_TREE=y
CONFIG_VFS=y
CONFIG_RAMFS=y
CONFIG_PROCFS=y
CONFIG_SYSFS=y
CONFIG_VFS_SMOKE_TEST=y
```

## fs/Kconfig
```kconfig
#
# 文件系统配置
#

menu "File Systems"

config VFS
	bool "Virtual File System (VFS)"
	default y
	help
	  启用虚拟文件系统层。
	  提供统一的文件操作接口。

config VFS_SMOKE_TEST
	bool "VFS boot smoke test"
	depends on VFS
	default n
	help
	  Create and read back /smoke.txt during application initialization.

config VFS_FD_CONCURRENCY_TEST
	bool "VFS descriptor concurrency test"
	depends on VFS && QEMU && BOARD_QEMU_STM32
	default n
	help
	  Exercise shared file offsets using scheduled tasks in QEMU.

config VFS_FAT_ALIAS_TEST
	bool "FatFs alias identity test"
	depends on VFS && FATFS && QEMU && BOARD_QEMU_STM32
	default n
	help
	  Test cached FatFs aliases, removal, rename, and mount protection.

config RAMFS
	bool "RAM file system"
	default y
	depends on VFS
	help
	  启用内存文件系统。

config PROCFS
	bool "Proc file system"
	default y
	depends on VFS
	help
	  启用 /proc 文件系统。
	  导出进程和系统信息。

config SYSFS
	bool "Sys file system"
	default y
	depends on VFS
	help
	  启用 /sys 文件系统。
	  导出设备和驱动信息。

config FATFS
	bool "FAT file system"
	default n
	depends on VFS
	help
	  启用 FAT 文件系统支持（FAT12/FAT16/FAT32）。

config FATFS_CODEPAGE
	int "FatFs OEM code page"
	default 936
	depends on FATFS
	help
	  FatFs OEM 代码页（例如 936 为简体中文 GBK，437 为美式单字节编码以节省 Flash）。

config LITTLEFS
	bool "LittleFS file system"
	default y if BOARD_NK60 || BOARD_NK60_V1
	default n
	depends on VFS
	help
	  启用 LittleFS 文件系统支持（专为 MCU 与 NOR Flash 设计的轻量级掉电安全文件系统）。

config ASSETS_FS_LITTLEFS
	bool "Mount LittleFS on /assets"
	default y if LITTLEFS && (BOARD_NK60 || BOARD_NK60_V1)
	default n
	depends on LITTLEFS
	help
	  在系统引导阶段，将 W25Q assets 分区以 LittleFS 文件系统格式挂载至 /assets。

endmenu
```
