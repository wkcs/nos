/*
 * Copyright (C) 2023-2026 Nick Hu <huqihan@live.com>
 *
 * QEMU netduinoplus2: STM32F405, matching the board linker script.
 */
/dts-v1/;
#include <arm/st/stm32f405.dtsi>

/ {
    compatible = "qemu,netduinoplus2", "st,stm32f405";
    model = "QEMU Netduino Plus 2";

    chosen {
        nos,console = <&uart1>;
    };
};

&uart1 {
    status = "okay";
};
