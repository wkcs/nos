/*
 * Copyright (C) 2023-2026 Nick Hu <huqihan@live.com>
 */

/dts-v1/;

/ {
    compatible = "linux,dummy-virt";
    model = "QEMU Virt Board";
    #address-cells = <2>;
    #size-cells = <2>;

    memory@40000000 {
        device_type = "memory";
        reg = <0x0 0x40000000 0x0 0x20000000>;
    };
};
