## Kconfig
```kconfig
#
# NOS 内核配置系统
# Copyright (C) 2023-2024 Nick Hu
#

mainmenu "NOS Kernel Configuration"

config VERSION_CODE
	int
	default 65536
	help
	  内核版本代码，格式为 (VERSION << 16) | (PATCHLEVEL << 8) | SUBLEVEL

config BUILD_INFO
	string
	default ""
	help
	  构建时间信息

# 架构选择
source "arch/Kconfig"

# SoC 芯片选择
source "soc/Kconfig"

# 编译器选择
menu "Compiler Configuration"

choice
	prompt "Compiler Selection"
	default CC_IS_GCC
	help
	  选择用于编译内核的编译器。

config CC_IS_GCC
	bool "GCC (GNU Compiler Collection)"
	help
	  使用 GCC 编译器。这是默认选项，
	  支持所有架构和功能。

config CC_IS_CLANG
	bool "Clang (LLVM Compiler)"
	help
	  使用 Clang/LLVM 编译器。
	  提供更好的诊断信息和优化。

endchoice

config CC_VERSION_TEXT
	string
	default "gcc" if CC_IS_GCC
	default "clang" if CC_IS_CLANG
	help
	  编译器版本文本标识。

config CC_HAS_ASM_GOTO
	bool
	default y if CC_IS_GCC
	default y if CC_IS_CLANG
	help
	  编译器支持 asm goto 语句。

config CC_HAS_WARN_MAYBE_UNINITIALIZED
	bool
	default y if CC_IS_GCC
	default n if CC_IS_CLANG
	help
	  编译器支持 -Wmaybe-uninitialized 警告。

endmenu

# 内核核心配置
menu "Kernel Configuration"

choice
	prompt "Kernel Architecture Mode"
	default KERNEL_MONOLITHIC
	help
	  选择内核运行架构模式：传统宏内核/RTOS 模式，或 Capability 微内核模式。

config KERNEL_MONOLITHIC
	bool "Monolithic / Classic RTOS kernel"
	help
	  传统单地址空间或宏内核模式，所有核心服务运行于内核态。

config KERNEL_MICROKERNEL
	bool "Capability-based Microkernel"
	help
	  微内核模式：内核仅保留线程调度、同步 Endpoint IPC、Notification、
	  Capability 句柄表、MMU/MPU 地址空间隔离与用户态 IRQ 转发。

endchoice

config SMP
	bool "Symmetric Multi-Processing (SMP) support"
	default n
	help
	  启用多核 SMP 支持。

config NR_CPUS
	int "Maximum number of CPUs"
	default 4 if SMP
	default 1
	range 1 8
	help
	  系统支持的最大 CPU 核心数。单核模式下固定为 1。

config SCHED_FAIR
	bool "Enable CFS/EEVDF Fair Scheduling Class (SCHED_NORMAL)"
	default y
	help
	  启用基于虚拟运行时间 (vruntime) 与 Nice 权重的公平调度类，与实时调度类并存。

config SCHED_CPULOAD
	bool "Track task CPU load statistics"
	default y
	help
	  启用任务 CPU 负载统计。

config KALLSYMS
	bool "Enable kernel symbol table lookup (kallsyms)"
	default y
	help
	  启用内核符号表查找，用于栈回溯、WCHAN 显示与异常现场解析。

config STACK_BACKTRACE
	bool "Enable cross-task stack backtrace and crash unwinder"
	default y
	help
	  启用零堆分配的双模栈回溯器（支持 Frame Pointer 与栈代码地址扫描）。

config BACKTRACE_MAX_DEPTH
	int "Maximum stack backtrace frame depth"
	depends on STACK_BACKTRACE
	default 12
	range 4 32
	help
	  栈回溯最大帧深度。

config PAGE_SIZE
	int "Page size"
	default 4096
	help
	  系统页面大小（字节）。
	  通常为 4096 字节。

config SYS_TICK_MS
	int "System tick period (ms)"
	default 1
	range 1 1000
	help
	  系统时钟滴答周期（毫秒）。
	  较小的值提供更好的响应性，但增加开销。

config MAX_PRIORITY
	int "Maximum task priority levels"
	default 32
	range 8 256
	help
	  任务优先级级别数量。
	  更多级别提供更细粒度的调度控制。

config STACK_GROWSUP
	bool "Stack grows upward"
	default n
	help
	  如果启用，栈向上增长（从低地址到高地址）。
	  大多数架构栈向下增长。

config IDEL_TASK_STACK_SIZE
	int "Idle task stack size"
	default 1024
	range 512 8192
	help
	  空闲任务的栈大小（字节）。

config CORE_TASK_STACK_SIZE
	int "Core task stack size"
	default 4096
	range 1024 16384
	help
	  核心任务的栈大小（字节）。

endmenu

# 内存管理配置
menu "Memory Management"

config MMU
	bool "Enable MMU support"
	default n
	depends on ARCH_HAS_MMU
	help
	  启用内存管理单元（MMU）支持。
	  提供虚拟内存、内存保护等功能。

config MPU
	bool "Enable MPU / PMP memory protection"
	default n
	depends on ARCH_HAS_MPU
	help
	  启用硬件 MPU (ARM Cortex-M) 或 PMP (RISC-V) 内存保护单元。

config MPU_STACK_GUARD
	bool "Enable 32-byte hardware MPU task stack guard"
	default y
	depends on MPU
	help
	  使用硬件 MPU Region 5 在当前运行任务栈底设置 32 字节禁访红区，实时捕获栈溢出。

config MM_TLSF
	bool "Enable TLSF O(1) low-fragmentation allocator"
	default y if !MMU
	help
	  启用 TLSF 二级位图紧凑边界标记分配器，消除页截断浪费与小内存碎片。

config MM_SLUB
	bool "Enable SLUB kmem_cache small-object allocator"
	default y
	help
	  启用 Linux 风格 SLUB (kmem_cache) 小对象分配器，支持与 Buddy/TLSF 并存。

config MM_DEBUG
	bool "Memory management debugging"
	default n
	help
	  启用内存管理调试功能。
	  包括内存泄漏检测、边界检查等。

config MAX_ORDER
	int "Maximum buddy allocator order"
	default 9
	range 5 15
	help
	  Buddy 分配器的最大阶数。
	  最大可分配块大小为 PAGE_SIZE * (2^MAX_ORDER)。

endmenu

# 标准库与 POSIX 兼容层配置
menu "Standard C Library (libc) and POSIX"

choice
	prompt "C Standard Library Selection"
	default LIBC_NEWLIB if ARCH_ARM
	default LIBC_MUSL if ARCH_ARM64 || ARCH_RISCV || ARCH_X86
	help
	  选择使用的 C 标准库实现。

config LIBC_MINIMAL
	bool "NOS Minimal internal klibc only"
	help
	  仅使用内核内置精简 string/vsprintf，不链接外部完整 libc。

config LIBC_NEWLIB
	bool "Toolchain Newlib / Newlib-nano"
	help
	  使用交叉编译工具链自带的 Newlib / Newlib-nano，通过 libs/libc/port 对接。

config LIBC_PICOLIBC
	bool "Picolibc (Lightweight embedded C library)"
	help
	  使用专为嵌入式优化的 Picolibc 标准库。

config LIBC_MUSL
	bool "musl libc (Full POSIX standard library for MMU targets)"
	depends on MMU || ARCH_ARM64 || ARCH_RISCV || ARCH_X86
	help
	  在带 MMU 的架构上使用完整的 musl C 标准库。

endchoice

config POSIX
	bool "Enable POSIX API compatibility layer (pthread, fd, signal, timer, mmap)"
	default y if LIBC_MUSL
	default n
	help
	  启用统一的 POSIX 兼容层接口。

endmenu

# 同步原语配置
menu "Synchronization"

config SPINLOCK_DEBUG
	bool "Spinlock debugging"
	default n
	help
	  启用自旋锁调试功能。
	  检测死锁、长时间持锁等问题。

endmenu

# 日志和控制台配置
menu "Logging and Console"

config DEFAULT_CONSOLE
	string "Default console device"
	default "tty0"
	help
	  默认控制台设备名称。

config CONSOLE_CRLF
	bool "Translate console LF to CRLF"
	default y
	help
	  串口控制台的文本输出将 LF 转换为 CRLF，适用于 minicom 等终端。
	  关闭后保持 LF；原始 UART 和文件数据不受影响。

config LOG_BUFFERED
	bool "Buffer complete log records"
	depends on !(ARCH_ARM64 && BOARD_QEMU_VIRT)
	default y
	help
	  使用固定大小的记录队列吸收串口突发输出。
	  ARM64 QEMU virt 当前只有 PL011 轮询端口，尚不支持后台排空。

config LOG_FIFO_BUF_SIZE
	int "Log FIFO buffer size"
	depends on LOG_BUFFERED
	default 512
	range 128 65536
	help
	  日志记录队列大小（字节），必须是 2 的幂。

config LOG_MESSAGE_SIZE
	int "Maximum formatted log message size"
	default 128 if BOARD_WL_001
	default 256 if ARCH_ARM
	default 512
	range 64 4096
	help
	  每次日志调用使用的格式化空间（字节，包含结尾 NUL）。

config LOG_COMPILE_LEVEL
	int "Compile-time minimum log severity"
	default 0
	range 0 6
	help
	  低于该级别的日志在编译时移除，参数也不会求值。
	  0=ALL, 1=DEBUG, 2=INFO, 3=WARNING, 4=ERROR, 5=FATAL, 6=OFF。

config DEFAULT_LOG_LEVEL
	int "Default log level"
	default 0
	range 0 6
	help
	  最低输出严重性（包含该级别）。
	  0=ALL, 1=DEBUG, 2=INFO, 3=WARNING, 4=ERROR, 5=FATAL, 6=OFF。

endmenu

# 终端和 Shell 配置
menu "Terminal"

config TTY
	bool "Raw TTY support"
	default y
	help
	  启用可裁剪的原始终端字节流；行编辑由 Shell 或上层服务负责。

config TTY_CANONICAL
	bool "Canonical TTY input and echo"
	depends on TTY
	default n
	help
	  可选的行缓冲、退格、回显和回车转换；默认仍为 raw 模式。

config TTY_LINE_SIZE
	int "Canonical TTY line buffer size"
	depends on TTY_CANONICAL
	default 128
	range 8 4096

endmenu

menu "Shell"

config SHELL
	bool "Enable shell"
	depends on TTY
	default n
	help
	  启用交互式 Shell 命令行界面。

config SHELL_STACK_SIZE
	int "Shell task stack size"
	depends on SHELL
	default 2048
	range 1024 65536

config SHELL_OUTPUT_SIZE
	int "Shell formatted output size"
	depends on SHELL
	default 256
	range 64 4096

config SHELL_PIPE_TEST
	bool "Shell stream pipe concurrency test"
	depends on QEMU && BOARD_QEMU_STM32
	default n
	help
	  Exercise shell pipe backpressure and EOF using scheduled QEMU tasks.

endmenu

# 测试配置
menu "Kernel Testing"

config KERNEL_TESTS
	bool "Enable kernel tests"
	default n
	help
	  启用内核测试框架。
	  包括属性测试和单元测试。

config PROPERTY_TESTS
	bool "Enable property-based tests"
	default y
	depends on KERNEL_TESTS
	help
	  启用基于属性的测试。
	  验证系统的通用正确性属性。

endmenu

# 设备树支持
menu "Device Tree"

config DEVICE_TREE
	bool "Enable device tree support"
	default n
	help
	  启用设备树（Device Tree）支持。
	  允许通过设备树描述硬件配置。

endmenu

# 驱动程序配置
source "drivers/Kconfig"

# 文件系统配置
source "fs/Kconfig"

# 板级配置
source "board/Kconfig"

# 应用与测试套件配置
menu "Applications and Tests"

config LUA
	bool "Enable Lua runtime"
	default n

config LVGL
	bool "Enable LVGL graphics library"
	default n

config TEST_APP
	bool "Enable general test application"
	default n

config RGB_TEST
	bool "Enable RGB matrix test"
	default n

config LCD_TEST
	bool "Enable LCD test"
	default n

config OLED_TEST
	bool "Enable OLED test"
	default n

config FATFS_TEST
	bool "Enable FatFS test"
	default n

endmenu
```

## arch/Kconfig
```kconfig
#
# 架构配置
#

choice
	prompt "Target Architecture"
	default ARCH_ARM
	help
	  选择目标架构。

config ARCH_ARM
	bool "ARM (32-bit)"
	select ARCH_HAS_IRQ
	select ARCH_HAS_MPU
	help
	  ARM 32 位架构支持（ARMv7-M, ARMv7-A 等）。

config ARCH_ARM64
	bool "ARM64 (64-bit)"
	select ARCH_HAS_IRQ
	select ARCH_HAS_MMU
	help
	  ARM 64 位架构支持（ARMv8-A, AArch64）。

config ARCH_RISCV
	bool "RISC-V (32/64-bit)"
	select ARCH_HAS_IRQ
	select ARCH_HAS_MMU
	select ARCH_HAS_MPU
	help
	  RISC-V 架构支持（RV32IMAC PMP 与 RV64GC Sv39/Sv48 MMU）。

config ARCH_X86
	bool "x86_64 (64-bit)"
	select ARCH_HAS_IRQ
	select ARCH_HAS_MMU
	help
	  x86_64 (AMD64/Intel 64) 架构支持。

endchoice

config ARCH
	string
	default "arm" if ARCH_ARM
	default "arm64" if ARCH_ARM64
	default "riscv" if ARCH_RISCV
	default "x86" if ARCH_X86

# 架构能力标志
config ARCH_HAS_MMU
	bool
	help
	  架构支持 MMU（内存管理单元）。

config ARCH_HAS_MPU
	bool
	help
	  架构支持 MPU 或 PMP 硬件内存保护单元。

config ARCH_HAS_IRQ
	bool
	help
	  架构支持中断控制器。

# 包含架构特定配置（标准 Kconfig 语法，子文件内部使用 if ARCH_* 守卫）
source "arch/arm/Kconfig"
source "arch/arm64/Kconfig"
source "arch/riscv/Kconfig"
source "arch/x86/Kconfig"
```

## arch/arm/Kconfig
```kconfig
#
# ARM 架构配置
#

if ARCH_ARM

choice
	prompt "ARM CPU Type"
	default ARM_CORTEX_M4
	help
	  选择 ARM CPU 类型。

config ARM_CORTEX_M3
	bool "Cortex-M3"
	help
	  ARM Cortex-M3 处理器支持。

config ARM_CORTEX_M4
	bool "Cortex-M4"
	help
	  ARM Cortex-M4 处理器支持（带 FPU）。

config ARM_CORTEX_A7
	bool "Cortex-A7"
	select ARCH_HAS_MMU
	help
	  ARM Cortex-A7 处理器支持。

endchoice

config CPU_TYPE
	string
	default "cortex-m3" if ARM_CORTEX_M3
	default "cortex-m4" if ARM_CORTEX_M4
	default "cortex-a7" if ARM_CORTEX_A7

config ARM_CORTEX_CPU
	bool
	default y
	help
	  ARM Cortex 系列 CPU。

config THUMB2_KERNEL
	bool "Use Thumb-2 instruction set"
	default y
	depends on ARM_CORTEX_M3 || ARM_CORTEX_M4
	help
	  使用 Thumb-2 指令集编译内核。
	  Cortex-M 系列处理器推荐启用。

config KERNEL_USE_BOOTLOADER
	bool "Kernel uses bootloader"
	default y
	help
	  内核通过 bootloader 加载。
	  如果启用，内核地址需要与 bootloader 配置匹配。

config KERNEL_ADDR
	hex "Kernel load address"
	default 0x08000000
	depends on KERNEL_USE_BOOTLOADER
	help
	  内核加载地址（十六进制）。
	  通常为 Flash 起始地址。

endif # ARCH_ARM
```

## arch/arm/configs/nk60-v2_defconfig
```kconfig
# NK60 V2 默认配置

# 架构
CONFIG_ARCH_ARM=y
CONFIG_ARM_CORTEX_M4=y
CONFIG_THUMB2_KERNEL=y
CONFIG_KERNEL_USE_BOOTLOADER=y
CONFIG_KERNEL_ADDR=0x08000000

# 板级
CONFIG_BOARD_NK60=y

# 内核配置
CONFIG_PAGE_SIZE=4096
CONFIG_SYS_TICK_MS=1
CONFIG_MAX_PRIORITY=32
CONFIG_STACK_GROWSUP=n
CONFIG_IDEL_TASK_STACK_SIZE=1024
CONFIG_CORE_TASK_STACK_SIZE=4096

# 内存管理
CONFIG_MMU=n
CONFIG_MM_DEBUG=y
CONFIG_MAX_ORDER=9

# 同步
CONFIG_SPINLOCK_DEBUG=y

# 日志和控制台
CONFIG_DEFAULT_CONSOLE="tty0"
CONFIG_LOG_FIFO_BUF_SIZE=512
CONFIG_CONSOLE_FIFO_BUF_SIZE=512
CONFIG_DEFAULT_LOG_LEVEL=0

# Shell
CONFIG_SHELL=n

# 设备树
CONFIG_DEVICE_TREE=n

# USB
CONFIG_USB=y
CONFIG_USB_DEVICE=y
CONFIG_USB_HID=y
CONFIG_USB_DEVICE_HID_KEYBOARD=y
CONFIG_USB_CDC=n
CONFIG_USB_WINUSB=y
CONFIG_USB_DEVICE_COMPOSITE=y

# UART
CONFIG_UART_DMA=n

# 键盘
CONFIG_KEYBOARD=y
CONFIG_NK60_V2_KEY=y

# 显示
CONFIG_DISPLAY_SERVER=y
CONFIG_NK60_DISPLAY_SERVER=y

# 板级驱动
CONFIG_NK60_V2_LED=y
CONFIG_NK60_V2_W25QXX=y
CONFIG_LED_DEV="nk60_v2-led"
CONFIG_FLASH_DEV="nk60_v2-flash"

# 文件系统
CONFIG_VFS=y
CONFIG_RAMFS=y
CONFIG_PROCFS=y
CONFIG_SYSFS=y
CONFIG_FATFS=n

# 服务器
CONFIG_CONNECT_SERVER=n
CONFIG_NDK_SERVER=y
```

## arch/arm/configs/qemu-stm32_defconfig
```kconfig
# QEMU STM32 golden / default config (slim refactor path)

# 架构
CONFIG_ARCH_ARM=y
CONFIG_ARM_CORTEX_M3=y
CONFIG_THUMB2_KERNEL=y
CONFIG_KERNEL_USE_BOOTLOADER=n
CONFIG_QEMU=y

# 板级 / SoC
CONFIG_BOARD_QEMU_STM32=y
CONFIG_SOC_STM32F1=y

# 内核配置
CONFIG_PAGE_SIZE=4096
CONFIG_SYS_TICK_MS=10
CONFIG_MAX_PRIORITY=256
CONFIG_STACK_GROWSUP=n
CONFIG_IDEL_TASK_STACK_SIZE=4096
CONFIG_CORE_TASK_STACK_SIZE=4096

# 内存管理
CONFIG_MMU=n
CONFIG_MM_DEBUG=y
CONFIG_MAX_ORDER=9

# 同步
CONFIG_SPINLOCK_DEBUG=y

# 日志和控制台
CONFIG_DEFAULT_CONSOLE="tty0"
CONFIG_LOG_FIFO_BUF_SIZE=4096
CONFIG_CONSOLE_FIFO_BUF_SIZE=512
CONFIG_DEFAULT_LOG_LEVEL=0

# Shell (optional)
CONFIG_SHELL=y

# 设备树
CONFIG_DEVICE_TREE=n

# Slim: disable USB / UI / display / keyboard / test apps
CONFIG_USB=n
CONFIG_UART_DMA=n
CONFIG_KEYBOARD=n
CONFIG_DISPLAY_SERVER=n
CONFIG_LVGL=n
CONFIG_LUA=n
CONFIG_TEST_APP=n
CONFIG_RGB_TEST=n
CONFIG_LCD_TEST=n
CONFIG_OLED_TEST=n
CONFIG_SDCARD_TEST=n
CONFIG_FATFS_TEST=n

# 文件系统 (keep FATFS/QEMU_SD until M3 ramdisk)
CONFIG_VFS=y
CONFIG_RAMFS=y
CONFIG_PROCFS=y
CONFIG_SYSFS=y
CONFIG_FATFS=y
CONFIG_SPI=y
CONFIG_QEMU_SD=y

# 服务器
CONFIG_CONNECT_SERVER=n
CONFIG_NDK_SERVER=n
```

## arch/arm64/Kconfig
```kconfig
#
# ARM64 架构配置
#

if ARCH_ARM64

choice
	prompt "ARM64 CPU Type"
	default ARM64_CORTEX_A53
	help
	  选择 ARM64 CPU 类型。

config ARM64_CORTEX_A53
	bool "Cortex-A53"
	help
	  ARM Cortex-A53 处理器支持。

config ARM64_CORTEX_A72
	bool "Cortex-A72"
	help
	  ARM Cortex-A72 处理器支持。

config ARM64_GENERIC
	bool "Generic ARMv8-A"
	help
	  通用 ARMv8-A 架构支持。

endchoice

config CPU_TYPE
	string
	default "cortex-a53" if ARM64_CORTEX_A53
	default "cortex-a72" if ARM64_CORTEX_A72
	default "generic" if ARM64_GENERIC

config ARM64_4K_PAGES
	bool "4KB page size"
	default y
	help
	  使用 4KB 页面大小。

config ARM64_64K_PAGES
	bool "64KB page size"
	depends on !ARM64_4K_PAGES
	help
	  使用 64KB 页面大小。

config ARM64_VA_BITS
	int "Virtual address space size"
	default 39
	range 36 48
	help
	  虚拟地址空间位数。
	  39 位支持 512GB 虚拟地址空间。

config ARM64_PA_BITS
	int "Physical address space size"
	default 40
	range 36 48
	help
	  物理地址空间位数。

endif # ARCH_ARM64
```

## arch/arm64/configs/defconfig
```kconfig
# ARM64 默认配置

# 架构
CONFIG_ARCH_ARM64=y
CONFIG_ARM64_CORTEX_A53=y
CONFIG_ARM64_4K_PAGES=y
CONFIG_ARM64_VA_BITS=39
CONFIG_ARM64_PA_BITS=40

# 编译器配置
CONFIG_CC_IS_GCC=y
# CONFIG_CC_IS_CLANG is not set
CONFIG_CC_VERSION_TEXT="gcc"
CONFIG_CC_HAS_ASM_GOTO=y
CONFIG_CC_HAS_WARN_MAYBE_UNINITIALIZED=y

# 板级
CONFIG_BOARD_QEMU_VIRT=y

# 内核配置
CONFIG_PAGE_SIZE=4096
CONFIG_SYS_TICK_MS=1
CONFIG_MAX_PRIORITY=32
CONFIG_STACK_GROWSUP=n
CONFIG_IDEL_TASK_STACK_SIZE=2048
CONFIG_CORE_TASK_STACK_SIZE=8192

# 内存管理
CONFIG_MMU=y
CONFIG_MM_DEBUG=n
CONFIG_MAX_ORDER=11

# 同步
CONFIG_SPINLOCK_DEBUG=n

# 日志和控制台
CONFIG_DEFAULT_CONSOLE="tty0"
CONFIG_LOG_FIFO_BUF_SIZE=1024
CONFIG_CONSOLE_FIFO_BUF_SIZE=1024
CONFIG_DEFAULT_LOG_LEVEL=6

# Shell
CONFIG_SHELL=y

# 设备树
CONFIG_DEVICE_TREE=y

# 测试
CONFIG_KERNEL_TESTS=n

# 文件系统
CONFIG_VFS=y
CONFIG_RAMFS=y
CONFIG_PROCFS=y
CONFIG_SYSFS=y
```

## arch/riscv/Kconfig
```kconfig
#
# RISC-V 架构配置
#

if ARCH_RISCV

choice
	prompt "RISC-V ISA Profile"
	default RISCV_64GC
	help
	  选择 RISC-V 处理器配置。

config RISCV_32IMAC
	bool "RV32IMAC (32-bit MCU profile with PMP)"
	help
	  32 位 RISC-V 微控制器配置（支持 M/U 态与 PMP）。

config RISCV_64GC
	bool "RV64GC (64-bit Application profile with Sv39/Sv48 MMU)"
	help
	  64 位 RISC-V 处理器配置（支持 M/S/U 态、SBI、PLIC/CLINT 与 Sv39/Sv48 页表）。

endchoice

config CPU_TYPE
	string
	default "rv32imac" if RISCV_32IMAC
	default "rv64gc" if RISCV_64GC

endif # ARCH_RISCV
```

## arch/x86/Kconfig
```kconfig
#
# x86_64 架构配置
#

if ARCH_X86

config X86_64
	bool "x86_64 (64-bit Long Mode)"
	default y
	help
	  启用 x86_64 64 位长模式（4 级页表、SYSCALL/SYSRET、Local APIC/IOAPIC）。

config CPU_TYPE
	string
	default "x86_64"

endif # ARCH_X86
```
