## board/Kconfig
```kconfig
#
# 板级配置
#

choice
	prompt "Target Board"
	default BOARD_NK60
	help
	  选择目标板。

config BOARD_NK60
	bool "NK60 V2"
	depends on ARCH_ARM
	help
	  NK60 V2 键盘板。

config BOARD_QEMU_STM32
	bool "QEMU STM32"
	depends on ARCH_ARM
	help
	  QEMU STM32 仿真板。

config BOARD_WL_001
	bool "WL-001"
	depends on ARCH_ARM
	help
	  WL-001 板。

config BOARD_ZJ_V3
	bool "ZJ V3"
	depends on ARCH_ARM
	help
	  ZJ V3 板。

config BOARD_NUTINY_NUC472
	bool "NuTiny-SDK-NUC472"
	depends on ARCH_ARM

config BOARD_QEMU_VIRT
	bool "QEMU Virt"
	depends on ARCH_ARM || ARCH_ARM64 || ARCH_RISCV || ARCH_X86
	help
	  QEMU Virt 通用仿真板。

endchoice

config BOARD
	string
	default "nk60-v2" if BOARD_NK60
	default "qemu-stm32" if BOARD_QEMU_STM32
	default "wl-001" if BOARD_WL_001
	default "zj-v3" if BOARD_ZJ_V3
	default "nutiny-nuc472" if BOARD_NUTINY_NUC472
	default "qemu-virt" if BOARD_QEMU_VIRT

config QEMU
	bool "Target runs under QEMU emulator"
	default y if BOARD_QEMU_STM32 || BOARD_QEMU_VIRT
	default n
	help
	  启用针对 QEMU 仿真环境的初始化与半主机/外设适配。

# 服务器配置
menu "Server Configuration"

config NLK_SERVER
	bool "NLK (NOS Link Kit) distributed soft-bus server"
	default y if BOARD_NK60
	default n
	help
	  启用 NLK (NOS Link Kit) 分布式软总线协议栈与能力服务（替代原 NDK 与 Connect Server）。

if NLK_SERVER

config NLK_PACKET_MTU
	int "NLK maximum L3 payload size (bytes)"
	default 256
	help
	  单个 NLK L3 报文的最大有效载荷字节数。

config NLK_MAX_BEARERS
	int "Maximum NLK physical bearers per node"
	default 6

config NLK_MAX_CAPS
	int "Maximum NLK capabilities per node"
	default 12

config NLK_MAX_CHILDREN
	int "Maximum cascaded child nodes tracked per node"
	default 8

endif

config NDK_SERVER
	bool "Legacy NDK server alias (selects NLK_SERVER)"
	default n
	select NLK_SERVER
	help
	  向后兼容配置项，自动启用 NLK_SERVER。

endmenu
```

## configs/nk60-v2_defconfig
```kconfig
# NK60 V2 Board Configuration (STM32F401 / Cortex-M4F)
CONFIG_ARCH_ARM=y
CONFIG_ARM_CORTEX_M4=y
CONFIG_ARM_CORTEX_M4_FPU=y
CONFIG_THUMB2_KERNEL=y
CONFIG_KERNEL_USE_BOOTLOADER=y
CONFIG_KERNEL_ADDR=0x08000000
CONFIG_SOC_STM32F4=y
CONFIG_BOARD_NK60=y
CONFIG_PAGE_SIZE=4096
CONFIG_SYS_TICK_MS=1
CONFIG_MAX_PRIORITY=32
CONFIG_STACK_GROWSUP=n
CONFIG_IDEL_TASK_STACK_SIZE=1024
CONFIG_CORE_TASK_STACK_SIZE=4096
CONFIG_MMU=n
CONFIG_MM_DEBUG=y
CONFIG_MAX_ORDER=9
CONFIG_SPINLOCK_DEBUG=y
CONFIG_DEFAULT_CONSOLE="tty0"
CONFIG_LOG_FIFO_BUF_SIZE=512
CONFIG_UART_RX_BUFFER_SIZE=256
CONFIG_UART_TX_BUFFER_SIZE=256
CONFIG_DEFAULT_LOG_LEVEL=0
CONFIG_SHELL=y
CONFIG_SHELL_STACK_SIZE=2048
CONFIG_USB=y
CONFIG_USB_DEVICE=y
CONFIG_USB_HID=y
CONFIG_USB_DEVICE_HID_KEYBOARD=y
CONFIG_USB_CDC=n
CONFIG_USB_WINUSB=y
CONFIG_USB_DEVICE_COMPOSITE=y
CONFIG_UART_DMA=n
CONFIG_KEYBOARD=y
CONFIG_NK60_V2_KEY=y
CONFIG_DISPLAY_SERVER=y
CONFIG_NK60_DISPLAY_SERVER=y
CONFIG_NK60_V2_LED=y
CONFIG_NK60_V2_W25QXX=y
CONFIG_KEY_DEV="nk60_v2-key"
CONFIG_LED_DEV="nk60_v2-led"
CONFIG_FLASH_DEV="nk60_v2-flash"
CONFIG_VFS=y
CONFIG_RAMFS=y
CONFIG_PROCFS=y
CONFIG_SYSFS=y
CONFIG_FATFS=n
CONFIG_NLK_SERVER=y
```

## configs/nutiny-nuc472_defconfig
```kconfig
CONFIG_ARCH_ARM=y
CONFIG_ARM_CORTEX_M4=y
CONFIG_ARM_CORTEX_M4_FPU=y
CONFIG_THUMB2_KERNEL=y
CONFIG_KERNEL_USE_BOOTLOADER=n
CONFIG_BOARD_NUTINY_NUC472=y
CONFIG_SOC_NUC472=y
CONFIG_PAGE_SIZE=1024
CONFIG_SYS_TICK_MS=10
CONFIG_MAX_PRIORITY=32
CONFIG_IDEL_TASK_STACK_SIZE=2048
CONFIG_CORE_TASK_STACK_SIZE=2048
CONFIG_MAX_ORDER=6
CONFIG_DEFAULT_CONSOLE="tty0"
CONFIG_LOG_FIFO_BUF_SIZE=512
CONFIG_SHELL=y
CONFIG_USB=n
CONFIG_RAMDISK=n
CONFIG_FATFS=n
CONFIG_NLK_SERVER=y
```

## configs/qemu-stm32_defconfig
```kconfig
# QEMU STM32 Board Configuration (QEMU netduinoplus2: STM32F405 / Cortex-M4F)
CONFIG_ARCH_ARM=y
CONFIG_ARM_CORTEX_M4=y
CONFIG_ARM_CORTEX_M4_FPU=y
CONFIG_THUMB2_KERNEL=y
CONFIG_KERNEL_USE_BOOTLOADER=n
CONFIG_QEMU=y
CONFIG_BOARD_QEMU_STM32=y
CONFIG_SOC_STM32F4=y
CONFIG_PAGE_SIZE=4096
CONFIG_SYS_TICK_MS=10
CONFIG_MAX_PRIORITY=256
CONFIG_STACK_GROWSUP=n
CONFIG_IDEL_TASK_STACK_SIZE=1024
CONFIG_CORE_TASK_STACK_SIZE=4096
CONFIG_MMU=n
CONFIG_MM_DEBUG=y
CONFIG_MAX_ORDER=9
CONFIG_SPINLOCK_DEBUG=y
CONFIG_DEFAULT_CONSOLE="tty0"
CONFIG_LOG_FIFO_BUF_SIZE=512
CONFIG_CONSOLE_FIFO_BUF_SIZE=512
CONFIG_DEFAULT_LOG_LEVEL=0
CONFIG_SHELL=y
CONFIG_USB=n
CONFIG_UART_DMA=n
CONFIG_KEYBOARD=n
CONFIG_DISPLAY_SERVER=n
CONFIG_LVGL=n
CONFIG_LUA=n
CONFIG_TEST_APP=n
CONFIG_VFS=y
CONFIG_RAMFS=y
CONFIG_PROCFS=y
CONFIG_SYSFS=y
CONFIG_RAMDISK=y
CONFIG_FATFS=y
CONFIG_SPI=y
CONFIG_QEMU_SD=y
CONFIG_CONNECT_SERVER=n
CONFIG_NDK_SERVER=n
```

## configs/qemu-virt-arm64_defconfig
```kconfig
# QEMU Virt ARM64 Configuration (Cortex-A53, MMU + Microkernel + POSIX)
CONFIG_ARCH_ARM64=y
CONFIG_ARM64_CORTEX_A53=y
CONFIG_ARM64_4K_PAGES=y
CONFIG_ARM64_VA_BITS=39
CONFIG_ARM64_PA_BITS=40
CONFIG_BOARD_QEMU_VIRT=y
CONFIG_SOC_QEMU_VIRT=y
CONFIG_KERNEL_MICROKERNEL=y
CONFIG_MMU=y
CONFIG_LIBC_MUSL=y
CONFIG_POSIX=y
CONFIG_PAGE_SIZE=4096
CONFIG_SYS_TICK_MS=1
CONFIG_MAX_PRIORITY=32
CONFIG_IDEL_TASK_STACK_SIZE=2048
CONFIG_CORE_TASK_STACK_SIZE=8192
CONFIG_SHELL=y
CONFIG_DEVICE_TREE=y
CONFIG_VFS=y
CONFIG_RAMFS=y
CONFIG_PROCFS=y
CONFIG_SYSFS=y
```

## configs/zj-v3_defconfig
```kconfig
# ZJ-V3 Board Configuration (STM32F103HD / Cortex-M3)
CONFIG_ARCH_ARM=y
CONFIG_ARM_CORTEX_M3=y
CONFIG_THUMB2_KERNEL=y
CONFIG_BOARD_ZJ_V3=y
CONFIG_SOC_STM32F1=y
CONFIG_PAGE_SIZE=4096
CONFIG_DEFAULT_CONSOLE="tty0"
CONFIG_LOG_FIFO_BUF_SIZE=4096
CONFIG_DEFAULT_LOG_LEVEL=0
CONFIG_SYS_TICK_MS=10
CONFIG_MM_DEBUG=y
CONFIG_MAX_PRIORITY=256
CONFIG_STACK_GROWSUP=n
CONFIG_MAX_ORDER=9
CONFIG_SPINLOCK_DEBUG=y
CONFIG_USB=y
CONFIG_USB_DEVICE=y
CONFIG_USB_HID=y
CONFIG_USB_WINUSB=y
CONFIG_USB_DEVICE_HID_KEYBOARD=y
CONFIG_USB_DEVICE_COMPOSITE=y
CONFIG_UART_DMA=n
CONFIG_RGB_TEST=n
CONFIG_DISPLAY_SERVER=n
CONFIG_RGB_MATRIX=n
CONFIG_LED_DEV="rgb-matrix"
CONFIG_LUA=y
CONFIG_LVGL=n
CONFIG_ZJ_TFTLCD=n
CONFIG_IDEL_TASK_STACK_SIZE=1024
CONFIG_CORE_TASK_STACK_SIZE=4096
CONFIG_SPI_SDCARD=y
CONFIG_SDCARD_TEST=n
CONFIG_FATFS=y
CONFIG_FATFS_TEST=y
```
