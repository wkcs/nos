## drivers/Kconfig
```kconfig
#
# 驱动程序配置
#

menu "Device Drivers"

# USB 驱动
menu "USB Support"

config USB
	bool "USB support"
	default n
	help
	  启用 USB 支持。

if USB

config USB_DEVICE
	bool "USB device mode"
	default y
	help
	  启用 USB 设备模式。

config USB_HID
	bool "USB HID support"
	default n
	depends on USB_DEVICE
	help
	  启用 USB HID（人机接口设备）支持。

config USB_DEVICE_HID_KEYBOARD
	bool "USB HID keyboard"
	default n
	depends on USB_HID
	help
	  启用 USB HID 键盘设备。

config USB_CDC
	bool "USB CDC (Communications Device Class)"
	default n
	depends on USB_DEVICE
	help
	  启用 USB CDC 支持（虚拟串口）。

config USB_WINUSB
	bool "USB WinUSB support"
	default n
	depends on USB_DEVICE
	help
	  启用 WinUSB 支持。

config USB_DEVICE_COMPOSITE
	bool "USB composite device"
	default n
	depends on USB_DEVICE
	help
	  启用 USB 复合设备支持。

endif # USB

endmenu

# 块设备驱动
menu "Block Devices"

config RAMDISK
	bool "RAM disk block device support"
	default n
	help
	  启用内存盘块设备驱动。

config BLOCK_SPI_SD
	bool "SPI SD card block device adapter"
	default n
	help
	  启用 SPI SD 卡块设备适配层。

endmenu

# SPI 与存储外设驱动
menu "SPI and Storage Drivers"

config SPI
	bool "SPI bus support"
	default n

config SPI_595
	bool "74HC595 SPI shift register driver"
	default n

config SPI_SDCARD
	bool "SPI SD card driver"
	default n

config QEMU_SD
	bool "QEMU SPI SD card emulation driver"
	default n

endmenu

# I2C 与 PWM 驱动
menu "I2C and PWM Drivers"

config I2C_CORE
	bool "I2C core support"
	default n

config STM32PWM
	bool "STM32 PWM driver"
	default n

endmenu

# UART 驱动
menu "UART Support"

config UART_BAUD_RATE
	int "Console UART baud rate"
	default 115200
	range 1200 4000000

config PL011_CLOCK_HZ
	int "QEMU virt PL011 input clock (Hz)"
	depends on ARCH_ARM64 && BOARD_QEMU_VIRT
	default 24000000
	range 1000000 1000000000

config UART_RX_BUFFER_SIZE
	int "UART receive buffer size"
	default 128 if BOARD_WL_001
	default 256
	range 16 65536
	help
	  USART 接收队列容量（字节），必须是 2 的幂。

config UART_TX_BUFFER_SIZE
	int "UART transmit buffer size"
	default 128 if BOARD_WL_001
	default 256
	range 16 65536
	help
	  USART 发送队列容量（字节），必须是 2 的幂。
	  建议不小于单条日志的最大格式化长度。

config UART_POLL_TIMEOUT
	int "UART polling timeout iterations"
	default 1000000
	range 1 100000000
	help
	  启动和 panic 轮询发送时等待 UART 就绪的最大循环次数。

config UART_DMA
	bool "UART DMA support"
	depends on (SOC_STM32F1 || SOC_STM32F4) && !BOARD_QEMU_STM32
	default n
	help
	  启用 STM32 UART DMA 发送。QEMU STM32F405 未模拟 DMA 控制器，
	  因此 QEMU 板使用中断发送。

config UART_DMA_BUFFER_SIZE
	int "UART DMA staging buffer size"
	depends on UART_DMA
	default 128
	range 16 4096
	help
	  DMA 传输期间独占的静态中转缓冲区（字节）。

config UART_DMA_STOP_TIMEOUT
	int "UART DMA stop timeout iterations"
	depends on UART_DMA
	default 4096
	range 1 1000000
	help
	  等待 DMA 通道停止时的最大循环次数。

endmenu

# 键盘驱动
config KEYBOARD
	bool "Keyboard server support"
	default n
	help
	  启用键盘系统服务（负责按键扫描消抖、层切换、HID 上报及 NLK keyboard 能力注册管理）。

# 显示驱动
menu "Display Support"

config DISPLAY_SERVER
	bool "Display server"
	default n
	help
	  启用显示服务器。

config DISPLAY_SERVER_DEMO
	bool "Display server drawing demo"
	default n
	depends on DISPLAY_SERVER

config NK60_DISPLAY_SERVER
	bool "NK60 display server"
	default n
	depends on DISPLAY_SERVER
	help
	  启用 NK60 板级显示服务器。

config RGB_MATRIX
	bool "RGB matrix driver"
	default n

config ZJ_TFTLCD
	bool "ZJ TFT LCD driver"
	default n

config ST7789_LCD
	bool "ST7789 LCD driver"
	default n

config SSD1106_OLED
	bool "SSD1106 OLED driver"
	default n

endmenu

# 板级特定驱动
menu "Board-specific Drivers"

config NK60_V1_KEY
	bool "NK60 V1 keyboard driver"
	default n

config NK60_V2_KEY
	bool "NK60 V2 keyboard driver"
	default n
	depends on KEYBOARD
	help
	  NK60 V2 板级键盘驱动。

config NK60_V2_LED
	bool "NK60 V2 LED driver"
	default n
	help
	  NK60 V2 板级 LED 驱动。

config NK60_V2_W25QXX
	bool "NK60 V2 W25Qxx flash driver"
	default n
	help
	  NK60 V2 板级 W25Qxx Flash 驱动。

config KEY_DEV
	string "Keyboard matrix device name"
	default "nk60_v2-key"
	help
	  底层键盘矩阵硬件驱动设备名称。

config LED_DEV
	string "LED device name"
	default "nk60_v2-led"
	help
	  LED 设备名称。

config FLASH_DEV
	string "Flash device name"
	default "nk60_v2-flash"
	help
	  Flash 设备名称。

endmenu

endmenu
```

## fs/Kconfig
```kconfig
#
# 文件系统配置
#

menu "File Systems"

config VFS
	bool "Virtual File System (VFS)"
	default y
	help
	  启用虚拟文件系统层。
	  提供统一的文件操作接口。

config VFS_SMOKE_TEST
	bool "VFS boot smoke test"
	depends on VFS
	default n
	help
	  Create and read back /smoke.txt during application initialization.

config VFS_FD_CONCURRENCY_TEST
	bool "VFS descriptor concurrency test"
	depends on VFS && QEMU && BOARD_QEMU_STM32
	default n
	help
	  Exercise shared file offsets using scheduled tasks in QEMU.

config RAMFS
	bool "RAM file system"
	default y
	depends on VFS
	help
	  启用内存文件系统。

config PROCFS
	bool "Proc file system"
	default y
	depends on VFS
	help
	  启用 /proc 文件系统。
	  导出进程和系统信息。

config SYSFS
	bool "Sys file system"
	default y
	depends on VFS
	help
	  启用 /sys 文件系统。
	  导出设备和驱动信息。

config FATFS
	bool "FAT file system"
	default n
	depends on VFS
	help
	  启用 FAT 文件系统支持（FAT12/FAT16/FAT32）。

endmenu
```

## ports/esp32/components/freertos/Kconfig
```kconfig
# Copyright (C) 2026 NOS contributors.
source "$IDF_PATH/components/freertos/Kconfig"
```

## ports/esp_idf/project/sdkconfig.defaults
```kconfig
# Copyright (C) 2026 NOS contributors.
CONFIG_IDF_TARGET="esp32s3"
CONFIG_FREERTOS_UNICORE=y
CONFIG_FREERTOS_HZ=100
CONFIG_FREERTOS_USE_TRACE_FACILITY=y
CONFIG_FREERTOS_USE_STATS_FORMATTING_FUNCTIONS=n
CONFIG_FREERTOS_DEBUG_OCDAWARE=n
CONFIG_FREERTOS_WATCHPOINT_END_OF_STACK=n
CONFIG_FREERTOS_TASK_FUNCTION_WRAPPER=n
CONFIG_ESP_TASK_WDT_EN=n
CONFIG_ESP_INT_WDT=n
CONFIG_ESP_MAIN_TASK_STACK_SIZE=8192
CONFIG_LOG_DEFAULT_LEVEL_INFO=y
CONFIG_ESPTOOLPY_FLASHSIZE_4MB=y
CONFIG_PARTITION_TABLE_CUSTOM=y
CONFIG_PARTITION_TABLE_CUSTOM_FILENAME="partitions.csv"
CONFIG_COMPILER_OPTIMIZATION_SIZE=y
CONFIG_ESP_TIMER_SUPPORTS_ISR_DISPATCH_METHOD=y
CONFIG_ESP_CONSOLE_SECONDARY_NONE=y
CONFIG_FREERTOS_ENABLE_TASK_SNAPSHOT=y
```

## soc/Kconfig
```kconfig
#
# SoC 芯片级配置
#

menu "SoC Configuration"

config SOC_STM32F1
	bool "STMicroelectronics STM32F1 Series (Cortex-M3)"
	depends on ARCH_ARM
	default y if BOARD_WL_001 || BOARD_ZJ_V3
	help
	  启用 STM32F10x 系列 SoC 外设与 CMSIS 支持。

config SOC_STM32F4
	bool "STMicroelectronics STM32F4 Series (Cortex-M4)"
	depends on ARCH_ARM
	default y if BOARD_NK60 || BOARD_QEMU_STM32
	help
	  启用 STM32F4xx 系列 SoC 外设与 CMSIS 支持。

# Part selections describe the silicon independently of the board name.
config SOC_STM32F401
	bool
	default y if BOARD_NK60 && SOC_STM32F4

config SOC_STM32F405
	bool
	default y if BOARD_QEMU_STM32 && SOC_STM32F4

config SOC_STM32F1_MD
	bool
	default y if BOARD_WL_001 && SOC_STM32F1

config SOC_STM32F1_HD
	bool
	default y if BOARD_ZJ_V3 && SOC_STM32F1

config SOC_NUC472
	bool "Nuvoton NUC472 (Cortex-M4)"
	depends on ARCH_ARM
	default y if BOARD_NUTINY_NUC472

config SOC_QEMU_VIRT
	bool "QEMU Generic Virtual Machine SoC"
	default y if BOARD_QEMU_VIRT
	help
	  启用 QEMU Virt 通用虚拟平台 SoC 支持。

endmenu
```
